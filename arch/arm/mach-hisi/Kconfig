## arch/arm/mach-hisi/Kconfig
```kconfig
config ARCH_HISI
	bool "Hisilicon SoC Support"
	depends on ARCH_MULTIPLATFORM
	select ARM_AMBA
	select ARM_GIC
	select ARM_TIMER_SP804
	select ARCH_WANT_OPTIONAL_GPIOLIB

if ARCH_HISI

menu "Hisilicon platform type"

config ARCH_HI3xxx
	bool "Hisilicon Hi36xx/Hi37xx family" if ARCH_MULTI_V7
	select CACHE_L2X0
	select CLKSRC_OF
	select GENERIC_CLOCKEVENTS
	select HAVE_ARM_SCU
	select HAVE_ARM_TWD if SMP
	select HAVE_SMP
	select PINCTRL
	select PINCTRL_SINGLE
	help
	  Support for Hisilicon Hi36xx/Hi37xx processor family

endmenu

endif
```
